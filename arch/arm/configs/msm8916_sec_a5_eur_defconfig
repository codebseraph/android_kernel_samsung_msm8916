## arch/arm/configs/msm8916_sec_a5_eur_defconfig
```kconfig
CONFIG_SEC_A5_EUR_PROJECT=y
CONFIG_MACH_A5_EUR_OPEN=y

# SEC_GPIO
CONFIG_SEC_GPIO_SETTINGS=y
CONFIG_LEDS_GPIO=y

# HARD RESET
CONFIG_RESTART_REASON_SEC_PARAM=y

# MUIC
CONFIG_SM5502_MUIC=y
CONFIG_MUIC_SUPPORT_RUSTPROOF_INBATT=y
CONFIG_USBID_STANDARD_VER_01=y
CONFIG_MUIC_SUPPORT_CHARGING_CABLE=y

# HALL IC
CONFIG_SENSORS_HALL=y

# VIBRATOR
CONFIG_SS_VIBRATOR=y

# DUAL SIM / SINGLE SIM Detection
CONFIG_CHECK_SIMSLOT_COUNT=y
CONFIG_CHECK_SIMSLOT_COUNT_DT=y

# Power off Alarm
CONFIG_RTC_AUTO_PWRON=y
CONFIG_RTC_AUTO_PWRON_PARAM=y

# AUDIO
CONFIG_AUDIO_SPEAKER_OUT_NXP_AMP_ENABLE=y
CONFIG_AUDIO_QUAT_I2S_ENABLE=y

# SENSORS
CONFIG_SENSORS=y
CONFIG_SENSORS_CORE=y
CONFIG_SENSOR_USE_SYMLINK=y
CONFIG_SYSFS=y
CONFIG_INPUT=y
CONFIG_INPUT_GPIO=y
CONFIG_INPUT_POLLDEV=y
CONFIG_SENSORS_TMD3782S=y
CONFIG_SENSORS_TMD3782S_VDD_LEDA=y

# DISPLAY
CONFIG_PANEL_EA8061V_AMS497EE01_HD=y
CONFIG_FB_MSM_MDSS_SAMSUNG=y

# Touch Key
CONFIG_INPUT_ENABLED=y
CONFIG_KEYBOARD_ABOV_TOUCH_A5=y

# Touch Screen
CONFIG_TOUCHSCREEN_MMS300_A=y

# BATTERY
CONFIG_MFD_RT5033=y
CONFIG_MFD_RT5033_RESET_GPIO=y
CONFIG_MFD_RT5033_SLDO_VBUSDET=n
CONFIG_BATTERY_SAMSUNG=y
CONFIG_BATTERY_SAMSUNG_DATA_FILE="a5_battery_data.h"
CONFIG_SAMSUNG_LPM_MODE=y
CONFIG_CHARGER_RT5033=y
CONFIG_FUELGAUGE_RT5033=y
CONFIG_REGULATOR_RT5033=y
CONFIG_BATTERY_SWELLING=y
CONFIG_SW_SELF_DISCHARGING=y

# BMC150
CONFIG_SENSORS_BMA2X2=y
CONFIG_SENSORS_BMM050=y
CONFIG_SENSORS_BMC150_VDD=y
CONFIG_SENSORS_BMA2X2_ENABLE_INT1=y
CONFIG_SENSORS_ACCELEROMETER_2G=y

# NFC
CONFIG_NFC=y
CONFIG_SEC_NFC=y
CONFIG_SEC_NFC_IF_I2C=y
CONFIG_SEC_NFC_PRODUCT_N5=y
CONFIG_SEC_NFC_USE_8916_BBCLK2=y

# FLASH
CONFIG_FLASHLIGHT=y
CONFIG_RT_FLASH_LED=y
CONFIG_FLED_RT5033=y
CONFIG_FLED_RT5033_EXT_GPIO=y

# CAMERA
CONFIG_SEC_A5_COMMON_CAMERA=y
CONFIG_IMX135=y
CONFIG_S5K5E3YX=y

# MMC
CONFIG_SEC_HYBRID_TRAY=y

# optimize mmc block delay on resume
CONFIG_MMC_BLOCK_DEFERRED_RESUME=y

#IPSec
CONFIG_CRYPTO_NULL=y
```
